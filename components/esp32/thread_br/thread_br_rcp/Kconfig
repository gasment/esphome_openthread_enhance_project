## components/esp32/thread_br/thread_br_rcp/Kconfig
```kconfig
menu "Thread BR features"
config THREAD_BR_WEB
    bool "Include Thread BR web management"
    default n
    help
        Enabled only when thread_br.web is explicitly configured.
config THREAD_BR_COMMISSIONER_WEB
    bool "Include Thread commissioner management resources"
    depends on THREAD_BR_WEB
    default n
    help
        Set automatically from thread_br.commissioner.enabled.
endmenu
```
