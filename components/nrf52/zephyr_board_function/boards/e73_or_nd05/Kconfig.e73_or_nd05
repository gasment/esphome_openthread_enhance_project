## components/nrf52/zephyr_board_function/boards/e73_or_nd05/Kconfig.e73_or_nd05
```kconfig
# SPDX-License-Identifier: Apache-2.0

config BOARD_E73_OR_ND05
	select SOC_NRF52840_QIAA
```

## components/nrf52/zephyr_board_function/boards/e73_or_nd05/board.yml
```yaml
board:
  name: e73_or_nd05
  full_name: Ebyte E73-2G4M08S1CX / RF-STAR RF-BM-ND05I carrier
  vendor: gasment
  socs:
    - name: nrf52840
```

## components/nrf52/zephyr_board_function/boards/e73_or_nd05/e73_or_nd05_nrf52840_defconfig
```kconfig
# SPDX-License-Identifier: Apache-2.0

CONFIG_ARM_MPU=y
CONFIG_GPIO=y
CONFIG_SOC_DCDC_NRF52X=n
```
